## Kconfig
```kconfig
# SPDX-License-Identifier: GPL-2.0
#
# For a description of the syntax of this configuration file,
# see Documentation/kbuild/kconfig-language.rst.
#
mainmenu "Linux/$(ARCH) $(KERNELVERSION) Kernel Configuration"

#ifdef CONFIG_OPLUS_SYSTEM_KERNEL
config OPLUS_SYSTEM_KERNEL_QCOM
  bool "config oplus system feature "
  default y
  help
	Define this config to distinguish between QCOM and MTK platform
#endif

source "scripts/Kconfig.include"

source "init/Kconfig"

source "kernel/Kconfig.freezer"

source "fs/Kconfig.binfmt"

source "mm/Kconfig"

source "net/Kconfig"

source "drivers/Kconfig"

source "fs/Kconfig"

source "security/Kconfig"

source "crypto/Kconfig"

source "lib/Kconfig"

source "lib/Kconfig.debug"

source "Documentation/Kconfig"
```

## drivers/input/oplus_fp_drivers/Kconfig
```kconfig
menuconfig OPLUS_FINGERPRINT
	bool "OPLUS fingerprint"
	depends on SPI_MASTER
	help
	  Say Y here to enable OPLUS fingerprint support

if OPLUS_FINGERPRINT
### fingerprint common config
config OPLUS_FINGERPRINT_COMMON
       default n
       tristate "Fingerprint common"

### platform config
config OPLUS_FINGERPRINT_QCOM
       default n
       tristate "Fingerprint base on QCOM"

### fingerprint sensor config
config OPLUS_FINGERPRINT_GOODIX_OPTICAL
       default n
       tristate "Fingerprint base on goodix optical chip"

config OPLUS_FINGERPRINT_JIIOV_OPTICAL
       default n
       tristate "Fingerprint base on jiiov optical chip"

endif #OPLUS_FINGERPRINT
```
